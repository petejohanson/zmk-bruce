## boards/arm/bruce/Kconfig.board
```kconfig
# josh-l-wang Bruce the keyboard configuration

# Copyright (c) 2024 The ZMK Contributors
# SPDX-License-Identifier: MIT

config BOARD_BRUCE
    bool "Bruce the keyboard"
    depends on SOC_STM32F072XB
    imply RETAINED_MEM
    imply RETENTION
    imply RETENTION_BOOT_MODE
```

## boards/arm/bruce/Kconfig.defconfig
```kconfig
# josh-l-wang Bruce the keyboard configuration

# Copyright (c) 2024 The ZMK Contributors
# SPDX-License-Identifier: MIT

if BOARD_BRUCE

config BOARD
    default "bruce"

config ZMK_KEYBOARD_NAME
    default "Bruce the keyboard"

endif # BOARD_BRUCE
```
